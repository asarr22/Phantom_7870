## arch/arm64/configs/exynos7870-phantom_defconfig
```kconfig
#
#
# PhantomKernel
#
CONFIG_CPU_THERMAL_IPA_CONTROL=y
CONFIG_CPU_THERMAL_IPA=y
CONFIG_ASMP=y
CONFIG_STATE_NOTIFIER=y
# CONFIG_CPU_FREQ_DEFAULT_GOV_BLU_ACTIVE is not set
# CONFIG_CPU_FREQ_DEFAULT_GOV_ONDEMANDPLUS is not set
CONFIG_CPU_FREQ_GOV_BLU_ACTIVE=y
CONFIG_CPU_FREQ_GOV_ONDEMANDPLUS=y
CONFIG_CPU_FREQ_GOV_ONDEMAND=y
# CONFIG_CPU_FREQ_DEFAULT_GOV_ONDEMAND is not set
CONFIG_QUICK_WAKEUP=y

# HMP
CONFIG_NR_CPUS=8
CONFIG_NR_CLUSTERS=2
CONFIG_SCHED_HMP=y
# CONFIG_SCHED_HMP_PRIO_FILTER is not set
CONFIG_HMP_FREQUENCY_INVARIANT_SCALE=y
# CONFIG_SCHED_HMP_LITTLE_PACKING is not set
CONFIG_DISABLE_CPU_SCHED_DOMAIN_BALANCE=y
CONFIG_HMP_FAST_CPU_MASK="4-7"
CONFIG_HMP_SLOW_CPU_MASK="0-3"
CONFIG_HMP_VARIABLE_SCALE=y
CONFIG_HMP_FREQUENCY_INVARIANT_SCALE=y
CONFIG_STORE_MODE=y
```

## arch/arm64/configs/exynos7870-treble_defconfig
```kconfig
#
#
# Treble defconfig
#
CONFIG_SDFAT_SUPPORT_DIR_SYNC=y
CONFIG_SDFAT_CHECK_RO_ATTR=y
CONFIG_EXT4_FS_POSIX_ACL=y
CONFIG_SDFAT_USE_FOR_VFAT=y
CONFIG_SDFAT_USE_FOR_EXFAT=y
```
